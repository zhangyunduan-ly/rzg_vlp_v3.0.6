## meta-ly/conf/layer.conf
```bitbake
# We have a conf and classes directory, add to BBPATH
BBPATH .= ":${LAYERDIR}"

# We have recipes-* directories, add to BBFILES
BBFILES += "${LAYERDIR}/recipes-*/*/*.bb \
            ${LAYERDIR}/recipes-*/*/*.bbappend"

BBFILE_COLLECTIONS += "meta-ly"
BBFILE_PATTERN_meta-ly = "^${LAYERDIR}/"
BBFILE_PRIORITY_meta-ly = "6"

LAYERDEPENDS_meta-ly = "core"
LAYERSERIES_COMPAT_meta-ly = "dunfell"
```

## meta-renesas/meta-rzg2l/conf/machine/ly-rzg2l.conf
```bitbake
#@TYPE: Machine
#@NAME: ly-rzg2l machine
#@DESCRIPTION: RZ/G2L SMARC platform

SOC_FAMILY = "r9a07g044l"
require conf/machine/include/rzg2l-common.inc
require conf/machine/include/cip-core.inc

DEFAULTTUNE ?= "cortexa55"

TUNE_CONF ?= "conf/machine/include/tune-cortexa55.inc"
require ${TUNE_CONF}

PREFERRED_PROVIDER_virtual/kernel="linux-renesas"

UBOOT_CONFIG ??= "ly-rzg2l"
UBOOT_CONFIG[ly-rzg2l] = "ly-rzg2l_defconfig"

# flash writer
EXTRA_IMAGEDEPENDS += " flash-writer"

# Support board with PMIC. Default:yes.
# With this option enabled, build both bin files for PMIC board and Concrete board.
PMIC_SUPPORT ?= "1"

# Supported devicetree
KERNEL_DEVICETREE = " \
	renesas/ly-rzg2l-smarc.dtb \
"

IMAGE_BOOT_FILES = " \
	bl2_bp-${MACHINE}_pmic.bin \
	bl2_bp-${MACHINE}.bin \
	fip-${MACHINE}_pmic.bin \
	fip-${MACHINE}.bin \
	bl2_bp-${MACHINE}_pmic.srec \
	bl2_bp-${MACHINE}.srec \
	fip-${MACHINE}_pmic.srec \
	fip-${MACHINE}.srec \
	Flash_Writer_SCIF_RZG2L_LY_PMIC_DDR4_1GB_1PCS.mot \
"
WIC_INPUT_DEPENDS = "firmware-pack:do_deploy flash-writer:do_deploy"
```
